## drivers/staging/Kconfig.rej
```kconfig
--- drivers/staging/Kconfig
+++ drivers/staging/Kconfig
@@ -132,4 +132,6 @@
 
 source "drivers/staging/ozwpan/Kconfig"
 
+source "drivers/staging/prima/Kconfig"
+
 endif # STAGING
```
